## config/boards/shields/paw/Kconfig.defconfig
```kconfig
# Copyright (c) 2022 The ZMK Contributors
# SPDX-License-Identifier: MIT

if SHIELD_PAW_RIGHT

config ZMK_KEYBOARD_NAME
    default "Paw"
    
config ZMK_SPLIT_ROLE_CENTRAL
    default y

endif

if SHIELD_PAW_LEFT || SHIELD_PAW_RIGHT

config ZMK_SPLIT
    default y

endif
```

## config/boards/shields/paw/Kconfig.shield
```kconfig
# Copyright (c) 2022 The ZMK Contributors
# SPDX-License-Identifier: MIT

config SHIELD_PAW_LEFT
    def_bool $(shields_list_contains,paw_left)

config SHIELD_PAW_RIGHT
    def_bool $(shields_list_contains,paw_right)
```
